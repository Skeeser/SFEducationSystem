/* USER CODE BEGIN Header */
/**
  ******************************************************************************
  * @file           : main.c
  * @brief          : Main program body
  ******************************************************************************
  * @attention
  *
  * <h2><center>&copy; Copyright (c) 2020 STMicroelectronics.
  * All rights reserved.</center></h2>
  *
  * This software component is licensed by ST under BSD 3-Clause license,
  * the "License"; You may not use this file except in compliance with the
  * License. You may obtain a copy of the License at:
  *                        opensource.org/licenses/BSD-3-Clause
  *
  ******************************************************************************
  */
/* USER CODE END Header */

/* Includes ------------------------------------------------------------------*/
#include "main.h"
#include "rtc.h"
#include "spi.h"
#include "usart.h"
#include "gpio.h"

/* Private includes ----------------------------------------------------------*/
/* USER CODE BEGIN Includes */

/* USER CODE END Includes */

/* Private typedef -----------------------------------------------------------*/
/* USER CODE BEGIN PTD */

/* USER CODE END PTD */

/* Private define ------------------------------------------------------------*/
/* USER CODE BEGIN PD */
/* USER CODE END PD */

/* Private macro -------------------------------------------------------------*/
/* USER CODE BEGIN PM */

/* USER CODE END PM */

/* Private variables ---------------------------------------------------------*/

/* USER CODE BEGIN PV */
const uint8_t gImage_black1[15000];
/* USER CODE END PV */

/* Private function prototypes -----------------------------------------------*/
void SystemClock_Config(void);
/* USER CODE BEGIN PFP */

/* USER CODE END PFP */

/* Private user code ---------------------------------------------------------*/
/* USER CODE BEGIN 0 */
void EPD_W21_WriteCMD(uint8_t cmd)
{
	HAL_GPIO_WritePin(GPIOB, SPI2_CS_Pin, GPIO_PIN_RESET);
	HAL_GPIO_WritePin(GPIOA, DC_Pin, GPIO_PIN_RESET);
	HAL_SPI_Transmit(&hspi2, &cmd, 1, 0xff);
	HAL_GPIO_WritePin(GPIOB, SPI2_CS_Pin, GPIO_PIN_SET);
}

void EPD_W21_WriteDATA(uint8_t dat)
{
	HAL_GPIO_WritePin(GPIOB, SPI2_CS_Pin, GPIO_PIN_RESET);
	HAL_GPIO_WritePin(GPIOA, DC_Pin, GPIO_PIN_SET);
	HAL_SPI_Transmit(&hspi2, &dat, 1, 0xff);
	HAL_GPIO_WritePin(GPIOB, SPI2_CS_Pin, GPIO_PIN_SET);
}

void lcd_chkstatus(void)
{
//	while(isEPD_W21_BUSY);  //1:BUSY,0:Free 
//	HAL_Delay(200);                       
}

void EPD_init(void)
{
	  HAL_GPIO_WritePin(GPIOA, RES_Pin, GPIO_PIN_RESET);
    HAL_Delay(100);
	  HAL_GPIO_WritePin(GPIOA, RES_Pin, GPIO_PIN_SET);
	  
  	EPD_W21_WriteCMD(0x12);			//SWRESET
		//lcd_chkstatus(); //waiting for the electronic paper IC to release the idle signal
	  HAL_Delay(100);
		EPD_W21_WriteCMD(0x74);
		EPD_W21_WriteDATA(0x54);
		EPD_W21_WriteCMD(0x7E);
		EPD_W21_WriteDATA(0x3B);
		EPD_W21_WriteCMD(0x2B);  // Reduce glitch under ACVCOM	
		EPD_W21_WriteDATA(0x04);           
		EPD_W21_WriteDATA(0x63);

		EPD_W21_WriteCMD(0x0C);  // Soft start setting
		EPD_W21_WriteDATA(0x8B);           
		EPD_W21_WriteDATA(0x9C);
		EPD_W21_WriteDATA(0x96);
		EPD_W21_WriteDATA(0x0F);

		EPD_W21_WriteCMD(0x01);  // Set MUX as 300
		EPD_W21_WriteDATA(0x2B);           
		EPD_W21_WriteDATA(0x01);
		EPD_W21_WriteDATA(0x00);     

		EPD_W21_WriteCMD(0x11);  // Data entry mode
		EPD_W21_WriteDATA(0x01);         
		EPD_W21_WriteCMD(0x44); 
		EPD_W21_WriteDATA(0x00); // RAM x address start at 0
		EPD_W21_WriteDATA(0x31); // RAM x address end at 31h(49+1)*8->400
		EPD_W21_WriteCMD(0x45); 
		EPD_W21_WriteDATA(0x2B);   // RAM y address start at 12Bh     
		EPD_W21_WriteDATA(0x01);
		EPD_W21_WriteDATA(0x00); // RAM y address end at 00h     
		EPD_W21_WriteDATA(0x00);
		EPD_W21_WriteCMD(0x3C); // board
		EPD_W21_WriteDATA(0x01); // HIZ

		EPD_W21_WriteCMD(0x18);
		EPD_W21_WriteDATA(0X80);
		EPD_W21_WriteCMD(0x22);
		EPD_W21_WriteDATA(0XB1);	//Load Temperature and waveform setting.
		EPD_W21_WriteCMD(0x20);
		//lcd_chkstatus(); //waiting for the electronic paper IC to release the idle signal
		HAL_Delay(400); 

		EPD_W21_WriteCMD(0x4E); 
		EPD_W21_WriteDATA(0x00);
		EPD_W21_WriteCMD(0x4F); 
		EPD_W21_WriteDATA(0x2B);
		EPD_W21_WriteDATA(0x01);
}
void EPD_refresh(void)
{
		EPD_W21_WriteCMD(0x22);			//DISPLAY REFRESH 	
		EPD_W21_WriteDATA(0xC7);
		EPD_W21_WriteCMD(0x20);
		//lcd_chkstatus(); //waiting for the electronic paper IC to release the idle signal
		HAL_Delay(1000); 
}	
void EPD_sleep(void)
{
    EPD_W21_WriteCMD(0X10);  	//deep sleep
		EPD_W21_WriteDATA(0x01);
}



void PIC_display(const unsigned char* picData_BW,const unsigned char* picData_R)
{
    unsigned int i;
		EPD_W21_WriteCMD(0x24);	       //Transfer BW data
	  for(i=0;i<15000;i++)	     
	{
	  EPD_W21_WriteDATA(~(*picData_BW));
	  picData_BW++;
	}
		EPD_W21_WriteCMD(0x26);		     //Transfer RED data
	  for(i=0;i<15000;i++)	     
	{
	  EPD_W21_WriteDATA(0);  
	  picData_R++;
	}

}
void PIC_display_Clean(void)
{
    unsigned int i;
		EPD_W21_WriteCMD(0x24);	       //Transfer BW data
	  for(i=0;i<15000;i++)	     
	{
	  EPD_W21_WriteDATA(0xff);
	}
	
		EPD_W21_WriteCMD(0x26);		     //Transfer RED data
	  for(i=0;i<15000;i++)	     
	{
	  EPD_W21_WriteDATA(0x00);
	}
}



/* USER CODE END 0 */

/**
  * @brief  The application entry point.
  * @retval int
  */
int main(void)
{
  /* USER CODE BEGIN 1 */

  /* USER CODE END 1 */
  

  /* MCU Configuration--------------------------------------------------------*/

  /* Reset of all peripherals, Initializes the Flash interface and the Systick. */
  HAL_Init();

  /* USER CODE BEGIN Init */

  /* USER CODE END Init */

  /* Configure the system clock */
  SystemClock_Config();

  /* USER CODE BEGIN SysInit */

  /* USER CODE END SysInit */

  /* Initialize all configured peripherals */
  MX_GPIO_Init();
  MX_RTC_Init();
  MX_SPI2_Init();
  MX_USART2_UART_Init();
  /* USER CODE BEGIN 2 */
  HAL_GPIO_WritePin(GPIOB, LCDEN_Pin, GPIO_PIN_RESET);
  /* USER CODE END 2 */

  /* Infinite loop */
  /* USER CODE BEGIN WHILE */
	EPD_init(); //EPD init
	PIC_display(gImage_black1,gImage_black1);//EPD_picture1
	EPD_refresh();//EPD_refresh		
	EPD_sleep();//EPD_sleep,Sleep instruction is necessary, please do not delete!!!
	HAL_Delay(80);
  while (1)
  {


		//EPD_Clean
//		EPD_init(); //EPD init
//	  PIC_display_Clean();//EPD_Clean
//		EPD_refresh();//EPD_refresh		
//		EPD_sleep();//EPD_sleep,Sleep instruction is necessary, please do not delete!!!
//		HAL_Delay(80);	
    /* USER CODE END WHILE */

    /* USER CODE BEGIN 3 */
  }
  /* USER CODE END 3 */
}

/**
  * @brief System Clock Configuration
  * @retval None
  */
void SystemClock_Config(void)
{
  RCC_OscInitTypeDef RCC_OscInitStruct = {0};
  RCC_ClkInitTypeDef RCC_ClkInitStruct = {0};
  RCC_PeriphCLKInitTypeDef PeriphClkInitStruct = {0};

  /** Configure the main internal regulator output voltage 
  */
  __HAL_RCC_PWR_CLK_ENABLE();
  __HAL_PWR_VOLTAGESCALING_CONFIG(PWR_REGULATOR_VOLTAGE_SCALE2);
  /** Initializes the CPU, AHB and APB busses clocks 
  */
  RCC_OscInitStruct.OscillatorType = RCC_OSCILLATORTYPE_HSI|RCC_OSCILLATORTYPE_LSI;
  RCC_OscInitStruct.HSIState = RCC_HSI_ON;
  RCC_OscInitStruct.HSICalibrationValue = RCC_HSICALIBRATION_DEFAULT;
  RCC_OscInitStruct.LSIState = RCC_LSI_ON;
  RCC_OscInitStruct.PLL.PLLState = RCC_PLL_NONE;
  if (HAL_RCC_OscConfig(&RCC_OscInitStruct) != HAL_OK)
  {
    Error_Handler();
  }
  /** Initializes the CPU, AHB and APB busses clocks 
  */
  RCC_ClkInitStruct.ClockType = RCC_CLOCKTYPE_HCLK|RCC_CLOCKTYPE_SYSCLK
                              |RCC_CLOCKTYPE_PCLK1|RCC_CLOCKTYPE_PCLK2;
  RCC_ClkInitStruct.SYSCLKSource = RCC_SYSCLKSOURCE_HSI;
  RCC_ClkInitStruct.AHBCLKDivider = RCC_SYSCLK_DIV1;
  RCC_ClkInitStruct.APB1CLKDivider = RCC_HCLK_DIV1;
  RCC_ClkInitStruct.APB2CLKDivider = RCC_HCLK_DIV1;

  if (HAL_RCC_ClockConfig(&RCC_ClkInitStruct, FLASH_LATENCY_0) != HAL_OK)
  {
    Error_Handler();
  }
  PeriphClkInitStruct.PeriphClockSelection = RCC_PERIPHCLK_RTC;
  PeriphClkInitStruct.RTCClockSelection = RCC_RTCCLKSOURCE_LSI;
  if (HAL_RCCEx_PeriphCLKConfig(&PeriphClkInitStruct) != HAL_OK)
  {
    Error_Handler();
  }
}

/* USER CODE BEGIN 4 */
const uint8_t gImage_black1[15000]  = { 
0X00,0X00,0X04,0X14,0X22,0X78,0X00,0X04,0X10,0X00,0X00,0X43,0X06,0X80,0X0E,0X05,
0X04,0X22,0X10,0X00,0X89,0X04,0X00,0X40,0X00,0X30,0X09,0X08,0X80,0X84,0X00,0X48,
0X22,0XA0,0X00,0X09,0X04,0X08,0X03,0X04,0X00,0X0E,0X00,0X00,0X00,0X00,0X00,0X00,
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0XFE,0X40,0X00,0X00,0X00,0X00,0X00,0X00,};

/* USER CODE END 4 */

/**
  * @brief  This function is executed in case of error occurrence.
  * @retval None
  */
void Error_Handler(void)
{
  /* USER CODE BEGIN Error_Handler_Debug */
  /* User can add his own implementation to report the HAL error return state */

  /* USER CODE END Error_Handler_Debug */
}

#ifdef  USE_FULL_ASSERT
/**
  * @brief  Reports the name of the source file and the source line number
  *         where the assert_param error has occurred.
  * @param  file: pointer to the source file name
  * @param  line: assert_param error line source number
  * @retval None
  */
void assert_failed(uint8_t *file, uint32_t line)
{ 
  /* USER CODE BEGIN 6 */
  /* User can add his own implementation to report the file name and line number,
     tex: printf("Wrong parameters value: file %s on line %d\r\n", file, line) */
  /* USER CODE END 6 */
}
#endif /* USE_FULL_ASSERT */

/************************ (C) COPYRIGHT STMicroelectronics *****END OF FILE****/
